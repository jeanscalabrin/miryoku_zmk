// Copyright 2022 Manna Harbour
// https://github.com/manna-harbour/miryoku

/ {
  behaviors {
    u_mt: u_mt {
      compatible = "zmk,beavior-hold-tap";
      #binding-cells = <2>;
      tapping-term-ms = <200>;
      flavor = "balanced";
      bindings = <&kp>, <&kp>;
      quick-tap-ms = <0>;                // repeat on tap-into-hold
    };
    u_lt: u_lt {
      compatible = "zmk,behavior-hold-tap";
      #binding-cells = <2>;
      tapping-term-ms = <200>;
      flavor = "balanced";
      bindings = <&mo>, <&kp>;
      quick-tap-ms = <0>;                // repeat on tap-into-hold
    };
  };
};
